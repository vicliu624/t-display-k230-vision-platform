// SPDX-License-Identifier: GPL-2.0-only OR BSD-2-Clause
/dts-v1/;

#include "k230-tdvp-minimal.dtsi"

/ {
	model = "LILYGO T-Display K230";
	compatible = "lilygo,t-display-k230", "canaan,k230";

	memory@0 {
		device_type = "memory";
		reg = <0x0 0x00000000 0x0 0x40000000>;
	};
};

&uart0 {
	status = "okay";
};
