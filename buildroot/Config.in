## buildroot/Config.in
```kconfig
menu "T-Display K230 Vision Platform"

source "$BR2_EXTERNAL_TDVP_PATH/package/tdvp-display-smoke/Config.in"
source "$BR2_EXTERNAL_TDVP_PATH/package/tdvp-keyboard-smoke/Config.in"
source "$BR2_EXTERNAL_TDVP_PATH/package/tdvp-k230-iomux/Config.in"
source "$BR2_EXTERNAL_TDVP_PATH/package/tdvp-board-init/Config.in"

endmenu
```

## buildroot/configs/t_display_k230_vision_defconfig
```kconfig
# T-Display K230 Vision Platform Buildroot profile.
# Scope: minimal BusyBox rootfs plus the pinned K230 Linux SDK kernel baseline.
# The post-image hook owns sysimage packaging, but it only emits
# sysimage-sdcard.img after K230 SDK-derived boot artifacts are supplied.

BR2_riscv=y
BR2_RISCV_64=y
BR2_RISCV_ISA_RVC=y
BR2_TOOLCHAIN_BUILDROOT_UCLIBC=y
BR2_TOOLCHAIN_BUILDROOT_CXX=y
BR2_KERNEL_HEADERS_AS_KERNEL=y
# The selected K230 Linux SDK kernel is 6.6.36.
BR2_PACKAGE_HOST_LINUX_HEADERS_CUSTOM_6_6=y

BR2_TARGET_GENERIC_HOSTNAME="tdisplay-k230"
BR2_TARGET_GENERIC_ISSUE="T-Display K230 Vision Platform"
BR2_TARGET_GENERIC_ROOT_PASSWD="tdvp"
BR2_INIT_BUSYBOX=y
BR2_ROOTFS_DEVICE_CREATION_DYNAMIC_DEVTMPFS=y
BR2_SYSTEM_BIN_SH_BUSYBOX=y

BR2_TARGET_GENERIC_GETTY_PORT="ttyS0"
BR2_TARGET_GENERIC_GETTY_BAUDRATE_115200=y
BR2_GLOBAL_PATCH_DIR="$(BR2_EXTERNAL_TDVP_PATH)/board/t-display-k230/patches"
BR2_ROOTFS_POST_BUILD_SCRIPT="$(BR2_EXTERNAL_TDVP_PATH)/board/t-display-k230/post-build.sh"
BR2_ROOTFS_POST_IMAGE_SCRIPT="$(BR2_EXTERNAL_TDVP_PATH)/board/t-display-k230/post-image.sh"

BR2_PACKAGE_BUSYBOX_SHOW_OTHERS=y
BR2_PACKAGE_KMOD=y
BR2_PACKAGE_KMOD_TOOLS=y
BR2_PACKAGE_IPROUTE2=y
BR2_PACKAGE_DROPBEAR=y
BR2_PACKAGE_DROPBEAR_DISABLE_REVERSEDNS=y
BR2_PACKAGE_ETHTOOL=y
BR2_PACKAGE_IPERF3=y
BR2_PACKAGE_LSOF=y
BR2_PACKAGE_STRACE=y
BR2_PACKAGE_TCPDUMP=y
BR2_PACKAGE_I2C_TOOLS=y
BR2_PACKAGE_EVTEST=y
BR2_PACKAGE_LIBGPIOD=y
BR2_PACKAGE_LIBGPIOD_TOOLS=y
BR2_PACKAGE_IW=y
BR2_PACKAGE_WIRELESS_REGDB=y
BR2_PACKAGE_WIRELESS_TOOLS=y
BR2_PACKAGE_WIRELESS_TOOLS_IWCONFIG=y
BR2_PACKAGE_WPA_SUPPLICANT=y
BR2_PACKAGE_WPA_SUPPLICANT_NL80211=y
BR2_PACKAGE_WPA_SUPPLICANT_WEXT=y
BR2_PACKAGE_WPA_SUPPLICANT_CLI=y
BR2_PACKAGE_WPA_SUPPLICANT_PASSPHRASE=y
BR2_PACKAGE_RTL8189FS=y

BR2_PACKAGE_ALSA_UTILS=y
# BR2_PACKAGE_ALSA_UTILS_ALSAMIXER is not set
BR2_PACKAGE_ALSA_UTILS_APLAY=y
BR2_PACKAGE_ALSA_UTILS_AMIXER=y
BR2_PACKAGE_ALSA_UTILS_SPEAKER_TEST=y
BR2_PACKAGE_LIBV4L=y
BR2_PACKAGE_LIBV4L_UTILS=y
BR2_PACKAGE_SPI_TOOLS=y
BR2_PACKAGE_SPIDEV_TEST=y

BR2_PACKAGE_LIBDRM=y
BR2_PACKAGE_LIBDRM_INSTALL_TESTS=y
BR2_PACKAGE_TDVP_BOARD_INIT=y
BR2_PACKAGE_TDVP_DISPLAY_SMOKE=y
BR2_PACKAGE_TDVP_KEYBOARD_SMOKE=y
BR2_PACKAGE_TDVP_K230_IOMUX=y

BR2_LINUX_KERNEL=y
BR2_LINUX_KERNEL_CUSTOM_GIT=y
BR2_LINUX_KERNEL_CUSTOM_REPO_URL="https://github.com/ruyisdk/linux-xuantie-kernel.git"
BR2_LINUX_KERNEL_CUSTOM_REPO_VERSION="7d4e1f444f461dbe3833bd99a4640e7b6c2cd529"
BR2_LINUX_KERNEL_DEFCONFIG="k230"
BR2_LINUX_KERNEL_CONFIG_FRAGMENT_FILES="$(BR2_EXTERNAL_TDVP_PATH)/kernel_config/t_display_k230_vision.fragment"
BR2_LINUX_KERNEL_IMAGE=y
BR2_LINUX_KERNEL_NEEDS_HOST_OPENSSL=y
BR2_LINUX_KERNEL_DTS_SUPPORT=y
BR2_LINUX_KERNEL_INTREE_DTS_NAME="canaan/tdisplay-k230 canaan/k230-canmv-v3"

BR2_TARGET_ROOTFS_EXT2=y
BR2_TARGET_ROOTFS_EXT2_4=y
BR2_TARGET_ROOTFS_EXT2_LABEL="tdvp-rootfs"
BR2_TARGET_ROOTFS_EXT2_SIZE="128M"
# BR2_TARGET_ROOTFS_TAR is not set

BR2_PACKAGE_HOST_GENIMAGE=y
BR2_PACKAGE_HOST_E2FSPROGS=y
BR2_PACKAGE_HOST_UBOOT_TOOLS=y
BR2_PACKAGE_HOST_UBOOT_TOOLS_ENVIMAGE=y
BR2_PACKAGE_HOST_UBOOT_TOOLS_ENVIMAGE_SOURCE="$(BR2_EXTERNAL_TDVP_PATH)/board/t-display-k230/uboot-linux.env"
BR2_PACKAGE_HOST_UBOOT_TOOLS_ENVIMAGE_SIZE="0x10000"
```

## buildroot/k230-sdk-overlay/package/gtk-layer-shell/Config.in
```kconfig
config BR2_PACKAGE_GTK_LAYER_SHELL
	bool "gtk-layer-shell"
	depends on BR2_PACKAGE_LIBGTK3_WAYLAND
	select BR2_PACKAGE_WAYLAND
	select BR2_PACKAGE_WAYLAND_PROTOCOLS
	help
	  GTK3 library for placing desktop components on a Wayland layer-shell.
	  It is used by sfwbar, the standard Labwc desktop panel.

comment "gtk-layer-shell needs the GTK3 Wayland backend"
	depends on !BR2_PACKAGE_LIBGTK3_WAYLAND
```

## buildroot/k230-sdk-overlay/package/gtk-session-lock/Config.in
```kconfig
config BR2_PACKAGE_GTK_SESSION_LOCK
	bool "gtk-session-lock"
	depends on BR2_PACKAGE_LIBGTK3_WAYLAND
	select BR2_PACKAGE_WAYLAND
	select BR2_PACKAGE_WAYLAND_PROTOCOLS
	help
	  GTK3 integration for the Wayland ext-session-lock protocol.
	  https://github.com/Cu3PO42/gtk-session-lock
```

## buildroot/k230-sdk-overlay/package/gtklock/Config.in
```kconfig
config BR2_PACKAGE_GTKLOCK
	bool "gtklock"
	depends on BR2_USE_MMU
	depends on BR2_PACKAGE_LINUX_PAM
	depends on BR2_PACKAGE_LIBGTK3_WAYLAND
	select BR2_PACKAGE_GTK_SESSION_LOCK
	help
	  Window-style Wayland session locker with TDVP's PAM account checks
	  and authenticated-only unlock. Requires ext-session-lock support.
	  https://github.com/jovanlanik/gtklock
```

## buildroot/k230-sdk-overlay/package/labwc/Config.in
```kconfig
config BR2_PACKAGE_LABWC
	bool "labwc"
	depends on BR2_PACKAGE_WLROOTS
	depends on BR2_USE_MMU
	select BR2_PACKAGE_CAIRO
	select BR2_PACKAGE_CAIRO_PNG
	select BR2_PACKAGE_LIBGLIB2
	select BR2_PACKAGE_LIBINPUT
	select BR2_PACKAGE_LIBPNG
	select BR2_PACKAGE_LIBXML2
	select BR2_PACKAGE_PANGO
	select BR2_PACKAGE_PIXMAN
	select BR2_PACKAGE_WAYLAND_PROTOCOLS
	help
	  Labwc is the wlroots-based Wayland compositor used by the TDVP
	  user-space session. The pinned 0.8.4 release targets wlroots 0.18.

comment "labwc needs an MMU and wlroots"
	depends on !BR2_USE_MMU || !BR2_PACKAGE_WLROOTS
```

## buildroot/k230-sdk-overlay/package/libfm-extra/Config.in
```kconfig
config BR2_PACKAGE_LIBFM_EXTRA
	bool "libfm-extra"
	depends on BR2_USE_MMU
	select BR2_PACKAGE_LIBGLIB2
	help
	  Build the small libfm-extra support library used by libmenu-cache.
	  It is kept as an independent package to break the upstream
	  libfm -> libmenu-cache dependency cycle.

comment "libfm-extra needs an MMU"
	depends on !BR2_USE_MMU
```

## buildroot/k230-sdk-overlay/package/libfm/Config.in
```kconfig
config BR2_PACKAGE_LIBFM
	bool "libfm"
	depends on BR2_USE_MMU
	select BR2_PACKAGE_LIBGTK3
	select BR2_PACKAGE_LIBMENU_CACHE
	help
	  Raspberry Pi maintained libfm, built with GTK3 support for the
	  Wayland desktop mode of PCManFM.

comment "libfm needs an MMU"
	depends on !BR2_USE_MMU
```

## buildroot/k230-sdk-overlay/package/libmenu-cache/Config.in
```kconfig
config BR2_PACKAGE_LIBMENU_CACHE
	bool "libmenu-cache"
	depends on BR2_USE_MMU
	select BR2_PACKAGE_LIBGLIB2
	select BR2_PACKAGE_LIBFM_EXTRA
	help
	  LXDE menu-cache library and daemon. It is used by Raspberry Pi's
	  desktop menu and by wf-panel-pi's window-list plugin to discover XDG
	  desktop entries.

comment "libmenu-cache needs an MMU"
	depends on !BR2_USE_MMU
```

## buildroot/k230-sdk-overlay/package/libnma/Config.in
```kconfig
config BR2_PACKAGE_LIBNMA
	bool "libnma"
	depends on BR2_PACKAGE_LIBGTK3
	depends on BR2_PACKAGE_NETWORK_MANAGER
	select BR2_PACKAGE_LIBSECRET
	help
	  GNOME's NetworkManager application widget library.  It is an upstream
	  dependency of Raspberry Pi's pplug-netman plugin and is packaged here
	  unchanged because Buildroot 2025.02.1 does not provide it.

comment "libnma needs GTK3 and NetworkManager"
	depends on !BR2_PACKAGE_LIBGTK3 || !BR2_PACKAGE_NETWORK_MANAGER
```

## buildroot/k230-sdk-overlay/package/nm-connection-editor/Config.in
```kconfig
config BR2_PACKAGE_NM_CONNECTION_EDITOR
	bool "nm-connection-editor"
	depends on BR2_USE_MMU
	depends on BR2_USE_WCHAR
	depends on BR2_TOOLCHAIN_HAS_THREADS
	depends on !BR2_STATIC_LIBS
	select BR2_PACKAGE_LIBGTK3
	select BR2_PACKAGE_LIBNMA
	select BR2_PACKAGE_LIBSECRET
	select BR2_PACKAGE_NETWORK_MANAGER
	help
	  Build the upstream GTK NetworkManager Connection Editor used by
	  wfplug-netman's "Edit Connections" action. This package deliberately
	  excludes the GNOME panel applet: Labwc and wf-panel-pi remain the
	  desktop and panel implementation.

comment "nm-connection-editor needs an MMU, wchar, threads and shared libraries"
	depends on !BR2_USE_MMU || !BR2_USE_WCHAR || !BR2_TOOLCHAIN_HAS_THREADS || BR2_STATIC_LIBS
```

## buildroot/k230-sdk-overlay/package/pcmanfm/Config.in
```kconfig
config BR2_PACKAGE_PCMANFM
	bool "pcmanfm (Raspberry Pi Wayland desktop)"
	depends on BR2_USE_MMU
	select BR2_PACKAGE_GTK_LAYER_SHELL
	select BR2_PACKAGE_LIBFM
	select BR2_PACKAGE_LIBGTK3
	select BR2_PACKAGE_LIBGTK3_WAYLAND
	help
	  Raspberry Pi's maintained PCManFM branch, built here for the Wayland
	  desktop path only. Desktop mode uses gtk-layer-shell as the background
	  surface and supplies icons plus context-menu behaviour, including touch
	  long press, without adding an X11 server to the image.

comment "pcmanfm needs an MMU"
	depends on !BR2_USE_MMU
```

## buildroot/k230-sdk-overlay/package/sfwbar/Config.in
```kconfig
config BR2_PACKAGE_SFWBAR
	bool "sfwbar"
	depends on BR2_PACKAGE_LIBGTK3_WAYLAND
	depends on BR2_PACKAGE_GTK_LAYER_SHELL
	select BR2_PACKAGE_DBUS
	select BR2_PACKAGE_JSON_C
	select BR2_PACKAGE_WAYLAND
	select BR2_PACKAGE_WAYLAND_PROTOCOLS
	help
	  Flexible Wayland panel with an application launcher, taskbar and
	  status widgets. It consumes the standard XDG desktop-entry database.

	  https://github.com/LBCrion/sfwbar

comment "sfwbar needs the GTK3 Wayland backend"
	depends on !BR2_PACKAGE_LIBGTK3_WAYLAND
```

## buildroot/k230-sdk-overlay/package/swayidle/Config.in
```kconfig
config BR2_PACKAGE_SWAYIDLE
	bool "swayidle"
	depends on BR2_USE_MMU
	depends on BR2_INIT_SYSTEMD
	select BR2_PACKAGE_WAYLAND
	select BR2_PACKAGE_WAYLAND_PROTOCOLS
	help
	  Idle-management client for Wayland compositors implementing
	  ext-idle-notify. TDVP starts it only inside the authenticated Labwc
	  session, where it locks before it powers down an output and locks again
	  before a logind sleep transition.

	  https://github.com/swaywm/swayidle

comment "swayidle needs an MMU and systemd/logind"
	depends on !BR2_USE_MMU || !BR2_INIT_SYSTEMD
```

## buildroot/k230-sdk-overlay/package/swaylock/Config.in
```kconfig
config BR2_PACKAGE_SWAYLOCK
	bool "swaylock"
	depends on BR2_USE_MMU
	depends on BR2_PACKAGE_LINUX_PAM
	select BR2_PACKAGE_CAIRO
	select BR2_PACKAGE_LIBXKBCOMMON
	select BR2_PACKAGE_WAYLAND
	select BR2_PACKAGE_WAYLAND_PROTOCOLS
	help
	  Swaylock is a small Wayland session-lock client. Labwc 0.8.4 supports
	  ext-session-lock, so this provides a real authenticated screen lock for
	  TDVP Quick Settings without a GNOME desktop component or a permanent
	  background process.

	  https://github.com/swaywm/swaylock

comment "swaylock needs an MMU and Linux PAM"
	depends on !BR2_USE_MMU || !BR2_PACKAGE_LINUX_PAM
```

## buildroot/k230-sdk-overlay/package/tdvp-camera-isp-runtime/Config.in
```kconfig
config BR2_PACKAGE_TDVP_CAMERA_ISP_RUNTIME
	bool
	depends on BR2_RISCV_64
	depends on BR2_TOOLCHAIN_USES_GLIBC
	select BR2_PACKAGE_MXML
```

## buildroot/k230-sdk-overlay/package/tdvp-camera-isp/Config.in
```kconfig
config BR2_PACKAGE_TDVP_CAMERA_ISP
	bool "TDVP CPU0 GC2093 camera"
	depends on BR2_INIT_SYSTEMD
	depends on BR2_LINUX_KERNEL
	depends on BR2_RISCV_64
	depends on !BR2_RISCV_ISA_RVV
	depends on BR2_TOOLCHAIN_USES_GLIBC
	select BR2_PACKAGE_TDVP_CAMERA_ISP_RUNTIME
	help
	  Board-specific GC2093 VVCAM modules, scalar-ISP ABI adapter and
	  supervised services. Requires the TDVP I2C4/managed-MCLK device tree.
	  Do not enable the vendor VVCAM package alongside this replacement.
```

## buildroot/k230-sdk-overlay/package/tdvp-cpu1-vision/Config.in
```kconfig
config BR2_PACKAGE_TDVP_CPU1_VISION
	bool "TDVP CPU1 AI/vision asynchronous bridge"
	depends on BR2_LINUX_KERNEL
	depends on BR2_INIT_SYSTEMD
	help
	  Load the ownership/transport bridge for the paired CPU1 RT-Smart
	  firmware. Linux holds shared suppliers but never drives the camera,
	  ISP, GNNE/KPU, AI2D or FFT. Applications in group video may read
	  bounded frame records from /dev/tdvp-vision; no physical mmap API.
	  No Linux camera demo or Linux nncase/KPU runtime is installed.
```

## buildroot/k230-sdk-overlay/package/tdvp-dejavu-fonts/Config.in
```kconfig
config BR2_PACKAGE_TDVP_DEJAVU_FONTS
	bool "TDVP DejaVu TrueType fonts"
	select BR2_PACKAGE_FONTCONFIG
	help
	  Install the DejaVu Sans family used by the Labwc desktop session,
	  the SFWBar panel, Foot, and other Pango-based Wayland clients.
```

## buildroot/k230-sdk-overlay/package/tdvp-display-smoke/Config.in
```kconfig
config BR2_PACKAGE_TDVP_DISPLAY_SMOKE
	bool "tdvp-display-smoke"
	depends on BR2_TOOLCHAIN_HAS_THREADS
	select BR2_PACKAGE_LIBDRM
	help
	  Install the TDVP board bring-up display validation tool.

	  This validation-only target tool opens DRM/KMS directly and performs
	  deterministic static patterns or bounded double-buffer atomic updates.
	  This is a manual maintenance diagnostic only: it must not run while
	  greetd or a Labwc desktop owns /dev/dri/card0.

comment "tdvp-display-smoke needs a toolchain w/ threads"
	depends on !BR2_TOOLCHAIN_HAS_THREADS
```

## buildroot/k230-sdk-overlay/package/tdvp-greetd/Config.in
```kconfig
config BR2_PACKAGE_TDVP_GREETD
	bool "greetd login manager"
	depends on BR2_INIT_SYSTEMD
	depends on BR2_PACKAGE_LINUX_PAM
	help
	  Install the greetd PAM login manager used by the graphical session.

comment "greetd login manager needs systemd and Linux-PAM"
	depends on !BR2_INIT_SYSTEMD || !BR2_PACKAGE_LINUX_PAM
```

## buildroot/k230-sdk-overlay/package/tdvp-greeter/Config.in
```kconfig
config BR2_PACKAGE_TDVP_GREETER
	bool "TDVP graphical login session"
	depends on BR2_INIT_SYSTEMD
	depends on BR2_PACKAGE_LINUX_PAM
	depends on BR2_PACKAGE_DBUS
	depends on BR2_PACKAGE_LABWC
	depends on BR2_PACKAGE_SEATD
	depends on BR2_PACKAGE_TDVP_GREETD
	depends on BR2_PACKAGE_TDVP_GTKGREET
	depends on BR2_PACKAGE_WLR_RANDR
	help
	  Install the board-aware greetd session and the greeter compositor
	  configuration for the T-Display K230.

comment "TDVP graphical login session needs systemd, Linux-PAM, Labwc, seatd, wlr-randr, greetd and gtkgreet"
	depends on !BR2_INIT_SYSTEMD || !BR2_PACKAGE_LINUX_PAM || !BR2_PACKAGE_DBUS || !BR2_PACKAGE_LABWC || !BR2_PACKAGE_SEATD || !BR2_PACKAGE_WLR_RANDR || !BR2_PACKAGE_TDVP_GREETD || !BR2_PACKAGE_TDVP_GTKGREET
```

## buildroot/k230-sdk-overlay/package/tdvp-gtkgreet/Config.in
```kconfig
config BR2_PACKAGE_TDVP_GTKGREET
	bool "gtkgreet graphical PAM client"
	select BR2_PACKAGE_JSON_C
	depends on BR2_PACKAGE_LIBGTK3
	depends on BR2_PACKAGE_LINUX_PAM
	depends on BR2_PACKAGE_DBUS
	depends on BR2_PACKAGE_WAYLAND
	depends on BR2_PACKAGE_GTK_LAYER_SHELL
	help
	  Install the GTK Wayland client for greetd.

comment "gtkgreet needs GTK3, gtk-layer-shell, Linux-PAM, D-Bus and Wayland"
	depends on !BR2_PACKAGE_LIBGTK3 || !BR2_PACKAGE_GTK_LAYER_SHELL || !BR2_PACKAGE_LINUX_PAM || !BR2_PACKAGE_DBUS || !BR2_PACKAGE_WAYLAND
```

## buildroot/k230-sdk-overlay/package/tdvp-keyboard-layout/Config.in
```kconfig
config BR2_PACKAGE_TDVP_KEYBOARD_LAYOUT
	bool "tdvp-keyboard-layout"
	depends on BR2_USE_MMU
	select BR2_PACKAGE_KBD
	help
	  Install the T-Display K230 virtual-console keyboard layout.

	  The detachable keyboard has a printed yellow Fn layer.  This package
	  installs the matching virtual-console map and the Wayland XKB symbols,
	  without changing the TCA8418 driver, DeviceTree keyboard bus, or evdev
	  event stream.

comment "tdvp-keyboard-layout needs an MMU"
	depends on !BR2_USE_MMU
```
