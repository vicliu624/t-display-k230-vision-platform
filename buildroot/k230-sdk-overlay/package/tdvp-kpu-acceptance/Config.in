## buildroot/k230-sdk-overlay/package/tdvp-kpu-acceptance/Config.in
```kconfig
config BR2_PACKAGE_TDVP_KPU_ACCEPTANCE
	bool "TDVP K230 KPU acceptance"
	depends on BR2_INIT_SYSTEMD
	select BR2_PACKAGE_AI2D_KPU
	help
	  Run the pinned K230 AI2D and GNNE kmodel acceptance workload at boot.
	  The service only records a pass after the model output matches the
	  supplied reference result.

comment "TDVP K230 KPU acceptance needs systemd"
	depends on !BR2_INIT_SYSTEMD
```

## buildroot/k230-sdk-overlay/package/tdvp-labwc-desktop/Config.in
```kconfig
config BR2_PACKAGE_TDVP_LABWC_DESKTOP
	bool "TDVP Labwc desktop session"
	depends on BR2_INIT_SYSTEMD
	select BR2_PACKAGE_DBUS
	select BR2_PACKAGE_FOOT
	select BR2_PACKAGE_GTK_LAYER_SHELL
	select BR2_PACKAGE_LABWC
	select BR2_PACKAGE_LIBGLIB2
	select BR2_PACKAGE_PCMANFM
	select BR2_PACKAGE_LIBRSVG
	select BR2_PACKAGE_LIBNMA
	select BR2_PACKAGE_LIBGTK3
	select BR2_PACKAGE_LIBGTK3_WAYLAND
	select BR2_PACKAGE_NETWORK_MANAGER
	select BR2_PACKAGE_PULSEAUDIO
	select BR2_PACKAGE_PULSEAUDIO_DAEMON
	select BR2_PACKAGE_SEATD
	select BR2_PACKAGE_WF_PANEL_PI
	select BR2_PACKAGE_WFPLUG_BATT
	select BR2_PACKAGE_WFPLUG_CLOCK
	select BR2_PACKAGE_WFPLUG_MENU
	select BR2_PACKAGE_WFPLUG_NETMAN
	select BR2_PACKAGE_WFPLUG_POWER
	select BR2_PACKAGE_WFPLUG_VOLUMEPULSE
	select BR2_PACKAGE_WPA_SUPPLICANT_DBUS
	select BR2_PACKAGE_WLR_RANDR
	select BR2_PACKAGE_SWAYIDLE
	select BR2_PACKAGE_UTIL_LINUX
	select BR2_PACKAGE_WLOPM
	help
	  Install the T-Display K230's standard Labwc desktop session.

	  Labwc remains the Wayland compositor. Raspberry Pi's maintained
	  wf-panel-pi supplies the single top panel and PCManFM owns the wallpaper,
	  desktop icons and context menu. Foot is the default terminal. The package
	  contains the XDG and systemd configuration for authenticated sessions.

comment "TDVP Labwc desktop session needs systemd"
	depends on !BR2_INIT_SYSTEMD
```

## buildroot/k230-sdk-overlay/package/tdvp-opkg-trust/Config.in
```kconfig
config BR2_PACKAGE_TDVP_OPKG_TRUST
	bool "TDVP signed opkg feed trust bootstrap"
	depends on BR2_INIT_SYSTEMD
	select BR2_PACKAGE_OPKG
	select BR2_PACKAGE_OPKG_GPG_SIGN
	select BR2_PACKAGE_GNUPG2
	help
	  Install the immutable TDVP repository public key and an operator-invoked
	  opkg wrapper. The wrapper initialises opkg's dedicated GnuPG home directly
	  before a package operation. The ABI-fixed HTTPS feed therefore retains
	  mandatory Packages.gz.asc verification without making graphical login
	  depend on GnuPG initialisation. No private signing material is installed
	  on the device.

comment "TDVP signed opkg feed trust bootstrap needs systemd"
	depends on !BR2_INIT_SYSTEMD
```

## buildroot/k230-sdk-overlay/package/tdvp-quick-settings/Config.in
```kconfig
config BR2_PACKAGE_TDVP_QUICK_SETTINGS
	bool "tdvp-quick-settings"
	depends on BR2_USE_MMU
	depends on BR2_PACKAGE_WAYLAND
	select BR2_PACKAGE_CAIRO
	select BR2_PACKAGE_WAYLAND_PROTOCOLS
	help
	  Native C++17 Wayland layer-shell Quick Settings panel for the
	  TDVP handheld desktop. It is an optional desktop enhancement and
	  does not replace Labwc, PCManFM, or wf-panel-pi.

	  The source is maintained independently at:
	    https://github.com/vicliu624/tdvp-quick-settings

comment "tdvp-quick-settings needs an MMU and Wayland"
	depends on !BR2_USE_MMU || !BR2_PACKAGE_WAYLAND
```

## buildroot/k230-sdk-overlay/package/tdvp-vglite-acceptance/Config.in
```kconfig
config BR2_PACKAGE_TDVP_VGLITE_ACCEPTANCE
	bool "tdvp-vglite-acceptance"
	depends on BR2_TOOLCHAIN_HAS_THREADS
	select BR2_PACKAGE_LIBDRM
	select BR2_PACKAGE_VG_LITE
	help
	  Install the bounded TDVP VGLite acceptance probe.

	  The probe is deliberately not a display diagnostic: it creates an
	  off-screen DRM dumb buffer, exports it as DMA-BUF, and renders into it
	  through VGLite. It never obtains DRM master, creates a framebuffer,
	  changes a mode, commits an atomic state, or flips a page. Run it as the
	  graphical login user before enabling VGLite inside wlroots. The package
	  also installs tdvp-vglite-client-churn: a bounded, opt-in wrapper which
	  repeatedly starts and exits this same off-screen probe while a VGLite
	  Labwc session is already active, testing the per-file kernel resource
	  ownership boundary without altering KMS state. The companion
	  tdvp-vglite-session-gate verifies the actual Labwc process environment
	  and renderer policy before running the fixed-panel wl_shm benchmark and
	  that churn workload; it never enables VGLite or changes the session.
	  tdvp-vglite-inflight-close-gate is a separate, opt-in fault-injection
	  command: it submits one off-screen command, exits without WAIT, then
	  proves that a new VGLite client can run normally after kernel recovery.

comment "tdvp-vglite-acceptance needs a toolchain w/ threads"
	depends on !BR2_TOOLCHAIN_HAS_THREADS
```

## buildroot/k230-sdk-overlay/package/tdvp-wayland-acceptance/Config.in
```kconfig
config BR2_PACKAGE_TDVP_WAYLAND_ACCEPTANCE
	bool "tdvp-wayland-acceptance"
	depends on BR2_TOOLCHAIN_HAS_THREADS
	select BR2_PACKAGE_LIBXKBCOMMON
	select BR2_PACKAGE_WAYLAND
	help
	  Install a bounded Wayland client probe. It validates the compositor
	  socket exposed by the TDVP graphical session, the advertised core
	  interfaces, the Wayland keyboard keymap delivery and the evdev/us XKB
	  configuration without opening DRM directly.

comment "tdvp-wayland-acceptance needs a toolchain w/ threads"
	depends on !BR2_TOOLCHAIN_HAS_THREADS
```

## buildroot/k230-sdk-overlay/package/tdvp-wayland-tools/Config.in
```kconfig
config BR2_PACKAGE_TDVP_WAYLAND_TOOLS
	bool "tdvp Wayland acceptance tools"
	depends on BR2_TOOLCHAIN_HAS_THREADS
	select BR2_PACKAGE_WAYLAND
	select BR2_PACKAGE_WAYLAND_PROTOCOLS
	help
	  Install compact tools used to verify the actual composed Wayland output.

comment "tdvp Wayland acceptance tools need a toolchain with threads"
	depends on !BR2_TOOLCHAIN_HAS_THREADS
```

## buildroot/k230-sdk-overlay/package/vicliu-pocket-linux-desktop/Config.in
```kconfig
config BR2_PACKAGE_VICLIU_POCKET_LINUX_DESKTOP
	bool "Vicliu Pocket Linux desktop integration"
	depends on BR2_INIT_SYSTEMD
	select BR2_PACKAGE_ALSA_UTILS
	select BR2_PACKAGE_FOOT
	select BR2_PACKAGE_IW
	select BR2_PACKAGE_MC
	select BR2_PACKAGE_MPV
	select BR2_PACKAGE_SUDO
	select BR2_PACKAGE_V4L2GRAB
	select BR2_PACKAGE_WOFI
	select BR2_PACKAGE_WVKBD
	select BR2_PACKAGE_WLR_RANDR
	select BR2_PACKAGE_YAVTA
	help
	  Installs the Wayland-native Pocket Linux launchers, XDG desktop entries
	  and privileged helper used by the T-Display K230 desktop profile.

	  Each visible action is backed by a Linux device, service, or utility:
	  Wi-Fi uses wpa_supplicant and systemd-networkd, display actions use the
	  board hardware utility and wlr-randr, and media/camera actions inspect
	  actual ALSA and V4L2 devices.

comment "Vicliu Pocket Linux desktop integration needs systemd"
	depends on !BR2_INIT_SYSTEMD
```

## buildroot/k230-sdk-overlay/package/vicliu-pocket-linux-hardware/Config.in
```kconfig
config BR2_PACKAGE_VICLIU_POCKET_LINUX_HARDWARE
	bool "T-Display K230 hardware services"
	depends on BR2_INIT_SYSTEMD
	depends on BR2_USE_MMU
	depends on BR2_TOOLCHAIN_HAS_THREADS
	depends on BR2_INSTALL_LIBSTDCPP
	depends on !BR2_STATIC_LIBS
	select BR2_PACKAGE_TDVP_KPU_ACCEPTANCE
	help
	  Install the Linux hardware state publisher and the hardware audit tool
	  for the LILYGO T-Display K230 V1.3. State is collected from kernel
	  device classes and system services. The package never claims a physical
	  capability until its Linux transport has materialized.

comment "T-Display K230 hardware services need systemd, an MMU, threads, C++ and shared libraries"
	depends on !BR2_INIT_SYSTEMD || !BR2_USE_MMU || !BR2_TOOLCHAIN_HAS_THREADS || !BR2_INSTALL_LIBSTDCPP || BR2_STATIC_LIBS
```

## buildroot/k230-sdk-overlay/package/wf-panel-pi/Config.in
```kconfig
config BR2_PACKAGE_WF_PANEL_PI
	bool "wf-panel-pi"
	depends on BR2_PACKAGE_LIBGTK3_WAYLAND
	depends on BR2_INSTALL_LIBSTDCPP
	depends on BR2_USE_MMU
	select BR2_PACKAGE_GLM
	select BR2_PACKAGE_GTK_LAYER_SHELL
	select BR2_PACKAGE_GTKMM3
	select BR2_PACKAGE_LIBEVDEV
	select BR2_PACKAGE_LIBINPUT
	select BR2_PACKAGE_LIBMENU_CACHE
	select BR2_PACKAGE_LIBXML2
	select BR2_PACKAGE_WAYLAND_PROTOCOLS
	help
	  Raspberry Pi's GTK3 Wayland desktop panel. TDVP uses its standard
	  layer-shell panel and plugin API on top of Labwc, with a TDVP-specific
	  theme and a deliberately small plugin set.

comment "wf-panel-pi needs GTK3 Wayland, C++ and an MMU"
	depends on !BR2_PACKAGE_LIBGTK3_WAYLAND || !BR2_INSTALL_LIBSTDCPP || !BR2_USE_MMU
```

## buildroot/k230-sdk-overlay/package/wfplug-batt/Config.in
```kconfig
config BR2_PACKAGE_WFPLUG_BATT
	bool "wf-panel-pi battery plugin"
	depends on BR2_PACKAGE_WF_PANEL_PI
	help
	  Raspberry Pi's battery monitor plugin, built for the wf-panel-pi
	  Wayland plugin ABI only.
```

## buildroot/k230-sdk-overlay/package/wfplug-clock/Config.in
```kconfig
config BR2_PACKAGE_WFPLUG_CLOCK
	bool "wf-panel-pi clock plugin"
	depends on BR2_PACKAGE_WF_PANEL_PI
	help
	  Raspberry Pi's panel clock plugin, built for the wf-panel-pi plugin API
	  only. The legacy LXPanel module is not included.
```

## buildroot/k230-sdk-overlay/package/wfplug-menu/Config.in
```kconfig
config BR2_PACKAGE_WFPLUG_MENU
	bool "wf-panel-pi menu plugin"
	depends on BR2_PACKAGE_WF_PANEL_PI
	select BR2_PACKAGE_LIBMENU_CACHE
	help
	  Raspberry Pi's XDG application menu plugin, built for the wf-panel-pi
	  plugin API only. The legacy LXPanel module is not included.
```

## buildroot/k230-sdk-overlay/package/wfplug-netman/Config.in
```kconfig
config BR2_PACKAGE_WFPLUG_NETMAN
	bool "wf-panel-pi NetworkManager plugin"
	depends on BR2_PACKAGE_WF_PANEL_PI
	depends on BR2_PACKAGE_NETWORK_MANAGER
	depends on BR2_PACKAGE_LIBNMA
	depends on BR2_PACKAGE_LIBSECRET
	help
	  Raspberry Pi's netman plugin for the wf-panel-pi Wayland ABI. It uses
	  the standard NetworkManager D-Bus API and libnma connection UI.

comment "wfplug-netman needs wf-panel-pi, NetworkManager, libnma and libsecret"
	depends on !BR2_PACKAGE_WF_PANEL_PI || !BR2_PACKAGE_NETWORK_MANAGER || \
		!BR2_PACKAGE_LIBNMA || !BR2_PACKAGE_LIBSECRET
```

## buildroot/k230-sdk-overlay/package/wfplug-power/Config.in
```kconfig
config BR2_PACKAGE_WFPLUG_POWER
	bool "wf-panel-pi power warning plugin"
	depends on BR2_PACKAGE_WF_PANEL_PI
	depends on BR2_PACKAGE_HAS_UDEV
	help
	  Raspberry Pi's upstream power and system-warning plugin for wf-panel-pi.

comment "wfplug-power needs wf-panel-pi and udev"
	depends on !BR2_PACKAGE_WF_PANEL_PI || !BR2_PACKAGE_HAS_UDEV
```

## buildroot/k230-sdk-overlay/package/wfplug-volumepulse/Config.in
```kconfig
config BR2_PACKAGE_WFPLUG_VOLUMEPULSE
	bool "wf-panel-pi PulseAudio volume plugin"
	depends on BR2_PACKAGE_WF_PANEL_PI
	depends on BR2_PACKAGE_PULSEAUDIO
	select BR2_PACKAGE_LIBCANBERRA
	help
	  Raspberry Pi's volumepulse plugin for the wf-panel-pi Wayland ABI.
	  It controls the standard PulseAudio protocol instead of TDVP-specific
	  ALSA and Wofi scripts, and uses libcanberra for standard desktop event
	  sounds when the output volume changes.

comment "wfplug-volumepulse needs wf-panel-pi and PulseAudio"
	depends on !BR2_PACKAGE_WF_PANEL_PI || !BR2_PACKAGE_PULSEAUDIO
```

## buildroot/k230-sdk-overlay/package/wlopm/Config.in
```kconfig
config BR2_PACKAGE_WLOPM
	bool "wlopm"
	depends on BR2_USE_MMU
	select BR2_PACKAGE_WAYLAND
	help
	  Small Wayland client for zwlr-output-power-management-v1. TDVP uses it
	  only after swaylock has established an authenticated session lock; it
	  temporarily powers outputs off without changing their Labwc layout.

	  https://git.sr.ht/~leon_plickat/wlopm

comment "wlopm needs an MMU"
	depends on !BR2_USE_MMU
```

## buildroot/k230-sdk-overlay/package/wofi/Config.in
```kconfig
config BR2_PACKAGE_WOFI
	bool "wofi"
	depends on BR2_PACKAGE_LIBGTK3_WAYLAND
	select BR2_PACKAGE_LIBXKBCOMMON
	select BR2_PACKAGE_WAYLAND
	select BR2_PACKAGE_WAYLAND_PROTOCOLS
	help
	  Wofi is a Wayland-native application launcher and dmenu replacement.
	  The Pocket Linux desktop uses it for the application and quick-action
	  menus, including the physical LILYGO key binding.

	  https://hg.sr.ht/~scoopta/wofi

comment "wofi needs the GTK3 Wayland backend"
	depends on !BR2_PACKAGE_LIBGTK3_WAYLAND
```

## buildroot/k230-sdk-overlay/package/wvkbd/Config.in
```kconfig
config BR2_PACKAGE_WVKBD
	bool "wvkbd"
	depends on BR2_PACKAGE_WAYLAND
	select BR2_PACKAGE_FONTCONFIG
	select BR2_PACKAGE_LIBXKBCOMMON
	select BR2_PACKAGE_PANGO
	select BR2_PACKAGE_PIXMAN
	help
	  A Wayland virtual keyboard. The mobile international layout is installed
	  for touch-only use of T-Display K230.

	  https://github.com/jjsullivan5196/wvkbd

comment "wvkbd needs Wayland"
	depends on !BR2_PACKAGE_WAYLAND
```

## buildroot/package/tdvp-board-init/Config.in
```kconfig
config BR2_PACKAGE_TDVP_BOARD_INIT
	bool "tdvp-board-init"
	select BR2_PACKAGE_KMOD
	select BR2_PACKAGE_TDVP_K230_IOMUX
	help
	  Install early TDVP board initialization scripts for the
	  T-Display K230 Buildroot image.

	  This package is for platform bring-up only. It loads board modules
	  that cannot rely on a full desktop/distro hotplug stack.
```

## buildroot/package/tdvp-display-smoke/Config.in
```kconfig
config BR2_PACKAGE_TDVP_DISPLAY_SMOKE
	bool "tdvp-display-smoke"
	depends on BR2_TOOLCHAIN_HAS_THREADS
	select BR2_PACKAGE_LIBDRM
	help
	  Install the TDVP board bring-up display smoke test.

	  This is a validation-only target tool. It opens DRM/KMS directly to
	  prove that the minimal Linux image can light the onboard display.
	  It is not part of the public BSP, runtime, SDK, or application API.

comment "tdvp-display-smoke needs a toolchain w/ threads"
	depends on !BR2_TOOLCHAIN_HAS_THREADS
```

## buildroot/package/tdvp-k230-iomux/Config.in
```kconfig
config BR2_PACKAGE_TDVP_K230_IOMUX
	bool "tdvp-k230-iomux"
	help
	  Install a small K230 IOMUX validation helper.

	  This is a bring-up tool, not an application API.  It is used to
	  mirror the LilyGO demo pinmux sequence until the K230 IOMUX path is
	  represented cleanly by kernel pinctrl and device tree.
```

## buildroot/package/tdvp-keyboard-smoke/Config.in
```kconfig
config BR2_PACKAGE_TDVP_KEYBOARD_SMOKE
	bool "tdvp-keyboard-smoke"
	depends on BR2_TOOLCHAIN_HEADERS_AT_LEAST_3_0
	select BR2_PACKAGE_LIBGPIOD
	help
	  Install the TDVP T-Display K230 keyboard smoke test.

	  This is a validation-only tool. It talks to the TCA8418 keyboard
	  controller through Linux i2c-dev and can pulse the LilyGO demo's
	  reset GPIO through libgpiod, to prove the keyboard hardware can be
	  detected and key events can be read before a stable BSP input API
	  exists.

	  It is not part of the public application API.

comment "tdvp-keyboard-smoke needs kernel headers >= 3.0"
	depends on !BR2_TOOLCHAIN_HEADERS_AT_LEAST_3_0
```
